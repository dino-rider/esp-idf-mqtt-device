## main/Kconfig.projbuild
```kconfig
menu "MQTT TEST SETUP"

    config MQTT_BROKER_URL
        string "Broker URL"
        default "mqtt://cloud.2smart.com"
        help
            URL of the broker to connect to

    config MQTT_BROKER_PORT
        int "Broker port"
        default 1883
        help
            port of the broker to connect to

    config MQTT_USERNAME
        string "MQTT Username hash"
        default "mqtt-login"
        help
            MQTT username (email) sha256 hash from connection Info

    config MQTT_PASSWORD
        string "Password"
        default "mqtt-password"
        help
            Password or token from connection Info

    config MQTT_DEVICE_ID
        string "Device ID"
        default "mqtt-device-id"
        help
            Device ID from connection Info

endmenu
```
